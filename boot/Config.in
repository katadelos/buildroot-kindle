## boot/Config.in
```kconfig
menu "Bootloaders"

source "boot/barebox/Config.in"
source "boot/uboot/Config.in"

endmenu
```

## configs/amazon_wario_defconfig
```kconfig
BR2_arm=y
BR2_cortex_a8=y
BR2_ARM_EABI=y
BR2_ARM_SOFT_FLOAT=y

BR2_LINUX_KERNEL=y
BR2_LINUX_KERNEL_CUSTOM_GIT=y
BR2_LINUX_KERNEL_CUSTOM_REPO_URL="https://github.com/katadelos/linux-3.0.35-lab126"
BR2_LINUX_KERNEL_CUSTOM_REPO_VERSION="master"
BR2_LINUX_KERNEL_USE_DEFCONFIG=y
BR2_LINUX_KERNEL_DEFCONFIG="imx60_wario"
BR2_TARGET_LDFLAGS="-Wl,-rpath,/mnt/us/buildroot/lib,-rpath,/mnt/us/buildroot/usr/lib"

BR2_TARGET_UBOOT=y
BR2_TARGET_UBOOT_BUILD_SYSTEM_LEGACY=y
BR2_TARGET_UBOOT_CUSTOM_GIT=y
BR2_TARGET_UBOOT_CUSTOM_REPO_URL="https://github.com/katadelos/uboot-2009.08-lab126"
BR2_TARGET_UBOOT_CUSTOM_REPO_VERSION="master"
BR2_TARGET_UBOOT_BOARDNAME="imx60_wario"
```

## configs/amazon_yoshi_defconfig
```kconfig
BR2_arm=y
BR2_cortex_a8=y
BR2_ARM_EABI=y
BR2_ARM_SOFT_FLOAT=y
BR2_TOOLCHAIN_BUILDROOT=y
BR2_TOOLCHAIN_BUILDROOT_GLIBC=y
BR2_PACKAGE_GLIBC_ALLOW_OLD_HEADERS=y
BR2_PACKAGE_GLIBC_VERSION_2_12=y
BR2_KERNEL_HEADERS_AS_KERNEL=y
BR2_PACKAGE_HOST_LINUX_HEADERS_CUSTOM_REALLY_OLD=y
BR2_LINUX_KERNEL=y
BR2_LINUX_KERNEL_CUSTOM_GIT=y
BR2_LINUX_KERNEL_CUSTOM_REPO_URL="https://github.com/katadelos/linux-2.6.31-lab126"
BR2_LINUX_KERNEL_CUSTOM_REPO_VERSION="ac6be64b207ab4f91ce02f3b39fb697a11aa720b"
BR2_LINUX_KERNEL_USE_DEFCONFIG=y
BR2_LINUX_KERNEL_DEFCONFIG="imx50_yoshi"
BR2_TARGET_LDFLAGS="-Wl,-rpath,/mnt/us/buildroot/lib,-rpath,/mnt/us/buildroot/usr/lib"
BR2_TARGET_UBOOT=y
BR2_TARGET_UBOOT_BUILD_SYSTEM_LEGACY=y
BR2_TARGET_UBOOT_CUSTOM_GIT=y
BR2_TARGET_UBOOT_CUSTOM_REPO_URL="https://github.com/katadelos/uboot-2009.08-lab126"
BR2_TARGET_UBOOT_CUSTOM_REPO_VERSION="origin/master"
BR2_TARGET_UBOOT_BOARDNAME="imx50_yoshi"
```

## package/fbink/Config.in
```kconfig
config BR2_PACKAGE_FBINK
	bool "fbink"
	help
	  FBInk is a small utility & library to print text & images to an eInk Linux framebuffer

	  https://github.com/NiLuJe/FBInk
```

## package/python-fbink/Config.in
```kconfig
config BR2_PACKAGE_PYTHON_FBINK
	bool "python-fbink"
	select BR2_PACKAGE_FBINK
	select BR2_PACKAGE_PYTHON_CFFI
	help
	  Python cFFI bindings for FBInk.
	  FBInk is a small utility & library to print text & images to an eInk Linux framebuffer

	  https://github.com/NiLuJe/py-fbink
```

## package/python-kindle/Config.in
```kconfig
config BR2_PACKAGE_PYTHON_KINDLE
	bool "python-kindle"
	select BR2_PACKAGE_PYTHON_CFFI
	help
	  Python cFFI bindings for Kindle.

	  https://github.com/katadelos/python-kindle
```
